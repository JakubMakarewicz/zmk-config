/* source keypos definitions */
#include "keypos.h"

/* map Zen's extra keys */
#define X_LH  &lt MEDIA ESC  // thumb row, left
#define X_RH  &lt FN DEL       // thumb row, right

/* activate bluetooth */
#define CONFIG_WIRELESS 1

/* source the main keymap */
#include "base.keymap"